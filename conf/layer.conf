## conf/layer.conf
```bitbake
# We have a conf and classes directory, add to BBPATH
BBPATH .= ":${LAYERDIR}"

# We have a packages directory, add to BBFILES
BBFILES += "${LAYERDIR}/recipes*/*/*.bb ${LAYERDIR}/recipes*/*/*.bbappend ${LAYERDIR}/recipes*/*/*.inc"

BBFILE_COLLECTIONS += "meta-albi"
BBFILE_PATTERN_meta-albi := "^${LAYERDIR}/"
BBFILE_PRIORITY_meta-albi = "9"
LAYERSERIES_COMPAT_meta-albi = "sumo thud warrior"
```
